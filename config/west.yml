## config/west.yml
```yaml
manifest:
  defaults:
    revision: main
  remotes:
    - name: zmkfirmware
      url-base: https://github.com/zmkfirmware
    - name: carrefinho
      url-base: https://github.com/carrefinho
    - name: manna-harbour
      url-base: https://github.com/manna-harbour

  projects:
    - name: zmk
      remote: zmkfirmware
      import: app/west.yml
    - name: forager-zmk-module
      remote: carrefinho
      revision: main
    - name: miryoku_zmk
      remote: manna-harbour
      revision: master
  self:
    path: config
```
